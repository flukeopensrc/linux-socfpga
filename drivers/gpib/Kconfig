## drivers/gpib/Kconfig
```kconfig
#
# NIOS2 gpib configuration
#
menuconfig GPIB
    bool "GPIB Support"
    help
      This enables GPIB If unsure, say N.

if GPIB
config FLUKE_GPIB
    tristate "FLUKE GPIB support"
    help
      This adds support for FLUKE's Custom GPIB.  The GPIB
      is implemented on an Altera FPGA fabric utilizing a cb7210
      vhdl design from Measurement Computing, which is connected
      to an pl330 DMA controller.  The GPIB driver code is
      based on the Linux GPIB project <http://linux-gpib.sf.net>, which was
      modified by Frank Mori Hess to suit an Altera-FPGA design.

      To compile gpib support as modules, choose M here: the modules
      will be called gpib_common, nec7210, and fluke_gpib.
endif
```
